## arch/arm64/Kconfig.projects
```kconfig
config SEC_A73XQ_PROJECT
	default n
	bool "Samsung A73XQ Project"
	help
	  Support for Samsung A73XQ Project

config MACH_A73XQ_EUR_OPEN
	default n
	bool "Samsung A73XQ EUR OPEN"
	help
	  Support for Samsung A73XQ EUR OPEN device.

config SEC_GTACT4PRO_PROJECT
	default n
	bool "Samsung GTACT4PRO Project"
	help
	  Support for Samsung GTACT4PRO Project

config MACH_GTACT4PRO_EUR_OPENX
	default n
	bool "Samsung GTACT4PRO EUR OPENX"
	help
	  Support for Samsung GTACT4PRO EUR OPENX device.

config SEC_GTACT4PROWIFI_PROJECT
	default n
	bool "Samsung GTACT4PROWIFI Project"
	help
	  Support for Samsung GTACT4PROWIFI Project

config MACH_GTACT4PROWIFI_EUR_OPEN
	default n
	bool "Samsung GTACT4PROWIFI EUR OPEN"
	help
	  Support for Samsung GTACT4PROWIFI EUR OPEN device.

config SEC_GTS7FEWIFI_PROJECT
        default n
        bool "Samsung GTS7FEWIFI Project"
        help
          Support for Samsung GTS7FEWIFI Project

config MACH_GTS7FEWIFI_EUR_OPEN
        default n
        bool "Samsung GTS7FEWIFI EUR OPEN"
        help
          Support for Samsung GTS7FEWIFI EUR OPEN device.

config SEC_XCOVERPRO2_PROJECT
	default n
	bool "Samsung XCOVERPRO2 Project"
	help
	  Support for Samsung XCOVERPRO2 Project

config MACH_XCOVERPRO2_EUR_OPEN
	default n
	bool "Samsung XCOVERPRO2 EUR OPEN"
	help
	  Support for Samsung XCOVERPRO2 EUR OPEN device.
```
