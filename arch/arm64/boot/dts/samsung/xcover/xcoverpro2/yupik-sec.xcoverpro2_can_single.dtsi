/* Copyright (c) 2019, The Linux Foundation. All rights reserved.
 *
 * This program is free software; you can redistribute it and/or modify
 * it under the terms of the GNU General Public License version 2 and
 * only version 2 as published by the Free Software Foundation.
 *
 * This program is distributed in the hope that it will be useful,
 * but WITHOUT ANY WARRANTY; without even the implied warranty of
 * MERCHANTABILITY or FITNESS FOR A PARTICULAR PURPOSE.  See the
 * GNU General Public License for more details.
 */

/* Please remove this code when you use it
&reserved_memory {

};

&soc {

};
*/
&wcd938x_codec {
	imp-table = <&imp_list 0 5 6>,
			 <&imp_list 6 23 8>,
			 <&imp_list 24 38 7>,
			 <&imp_list 39 100 6>,
			 <&imp_list 101 160 7>,
			 <&imp_list 161 400 8>,
			 <&imp_list 401 2000 8>,
			 <&imp_list 2001 0x7fffffff 6>;
};

