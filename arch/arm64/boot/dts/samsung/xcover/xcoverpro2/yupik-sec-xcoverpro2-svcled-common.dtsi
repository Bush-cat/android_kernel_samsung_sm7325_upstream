/* Copyright (c) 2016-2020, The Linux Foundation. All rights reserved.
 *
 * This program is free software; you can redistribute it and/or modify
 * it under the terms of the GNU General Public License version 2 and
 * only version 2 as published by the Free Software Foundation.
 *
 * This program is distributed in the hope that it will be useful,
 * but WITHOUT ANY WARRANTY; without even the implied warranty of
 * MERCHANTABILITY or FITNESS FOR A PARTICULAR PURPOSE.  See the
 * GNU General Public License for more details.
 */

/* SEC SVCLED setting */
&pm8350c_rgb {
	step = <120>;

	red {
		br_ratio_normal = <25>;
		br_ratio_lpm = <25>;
	};

	green {
		br_ratio_normal = <5>;
		br_ratio_lpm = <5>;
	};

	blue {
		br_ratio_normal = <22>;
		br_ratio_lpm = <22>;
	};
};
