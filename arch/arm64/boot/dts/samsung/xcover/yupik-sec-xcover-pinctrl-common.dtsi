/* Copyright (c) 2021, The Linux Foundation. All rights reserved.
 *
 * This program is free software; you can redistribute it and/or modify
 * it under the terms of the GNU General Public License version 2 and
 * only version 2 as published by the Free Software Foundation.
 *
 * This program is distributed in the hope that it will be useful,
 * but WITHOUT ANY WARRANTY; without even the implied warranty of
 * MERCHANTABILITY or FITNESS FOR A PARTICULAR PURPOSE.  See the
 * GNU General Public License for more details.
 */

&tlmm {
	wakeup-disabled-gpios = <
		0	/* CAM_PMIC_I2C_SDA_1P8 */
		3	/* LCD_ESD_DET */
		4	/* SPK_AMP_SDA_1P8 */
		8	/* GRIP2_SDA_1P8 */
		11	/* RCAM1_LDO_EN */
		12	/* IF_PMIC_SDA_1P8 */
		16	/* BLIC_I2C_SDA_1P8 */
		20	/* RCAM1_RST_N */
		21	/* RCAM3_RST_N */
		23	/* AP_UART_RXD */
		28	/* BT_UART_CTS */
		32	/* CC_SDA_1P8 */
		35	/* BTP_RST_N */
		36	/* NFC_SDA_1P8 */
		41	/* NFC_IRQ */
		44	/* LCD_RST_N */
		45	/* LCM_EN_1 */
		47	/* LCD_CON_DET */
		48	/* NFC_ESE_MISO */
		51	/* NFC_CS_N */
		52	/* NC */
		54	/* NC */
		55	/* NC */
		56	/* BTP_SPI_MISO */
		59	/* BTP_SPI_CS_N */
		60	/* TSP_SPI_MISO */
		61	/* TSP_SPI_MOSI */
		63	/* TSP_SPI_CSN */
		68	/* SIM_TYPE */
		72	/* FCAM_SENSOR_I2C_SCL_1P8 */
		75	/* CAM_AF_EEP_I2C_SDA_1P8 */
		77	/* FCAM_RST_N */
		78	/* NC */
		82	/* AP_USB_BOOT */
		83	/* CODEC_RST_N */
		90	/* NC */
		93	/* TSP_RST */
		95	/* BT_SLIMBUS_DATA */
		104	/* GRIP_LDO_EN */
		112	/* (NC) */
		116	/* NC */
		127	/* CP_WLAN_COEX_RXD */
		129	/* NC */
		130	/* NC */
		131	/* NC */
		136	/* NC */
		150	/* SPK_I2S3_BCLK */
		151	/* SPK_I2S3_WS */
		153	/* SPK_I2S3_DI */
		155	/* NC */
		156	/* NC */
		157	/* NC */
		159	/* SENSOR_SDA_1P8 */
		161	/* PROXY_SDA_1P8 */
		163	/* SENSOR_SPI_MISO */
		166	/* SENSOR_SPI_CS_N */
		172	/* BLE_UART_RXD */
		174	/* NC */
	>;
};


