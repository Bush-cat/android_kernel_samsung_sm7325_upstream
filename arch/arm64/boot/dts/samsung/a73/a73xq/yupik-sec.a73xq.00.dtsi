/* Copyright (c) 2021, The Linux Foundation. All rights reserved.
 *
 * This program is free software; you can redistribute it and/or modify
 * it under the terms of the GNU General Public License version 2 and
 * only version 2 as published by the Free Software Foundation.
 *
 * This program is distributed in the hope that it will be useful,
 * but WITHOUT ANY WARRANTY; without even the implied warranty of
 * MERCHANTABILITY or FITNESS FOR A PARTICULAR PURPOSE.  See the
 * GNU General Public License for more details.
 */

#include "../../yupik-sec-common.dtsi"

#include "../yupik-sec-a73-common.dtsi"
#include "../yupik-sec-a73-pinctrl-common.dtsi"
#include "../yupik-sec-a73-audio-common.dtsi"
#include "../yupik-sec-a73-audio-pinctrl-common.dtsi"
#include "../yupik-sec-a73-sensor-common.dtsi"
#include "../yupik-sec-a73-sensor-pinctrl-common.dtsi"
#include "./yupik-sec-a73xq-pm-common.dtsi"
#include "yupik-sec-a73xq-camera-sensor-common.dtsi"
#include "yupik-sec-a73xq-pinctrl-r00.dtsi"

/ {
	model = "Samsung A73XQ PROJECT (board-id,00)";
	qcom,msm-id = <475 0x10000>, <515 0x10000>;
	qcom,board-id = <34 0>;
	dtbo-version = <0>;
};

