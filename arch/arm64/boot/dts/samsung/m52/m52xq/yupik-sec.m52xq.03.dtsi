/* Copyright (c) 2021, The Linux Foundation. All rights reserved.
 *
 * This program is free software; you can redistribute it and/or modify
 * it under the terms of the GNU General Public License version 2 and
 * only version 2 as published by the Free Software Foundation.
 *
 * This program is distributed in the hope that it will be useful,
 * but WITHOUT ANY WARRANTY; without even the implied warranty of
 * MERCHANTABILITY or FITNESS FOR A PARTICULAR PURPOSE.  See the
 * GNU General Public License for more details.
 */

#include "../../yupik-sec-common.dtsi"

#include "../yupik-sec-m52-common.dtsi"
#include "../yupik-sec-m52-pinctrl-common.dtsi"
#include "../yupik-sec-m52-audio-common.dtsi"
#include "../yupik-sec-m52-audio-pinctrl-common.dtsi"
#include "../yupik-sec-m52-sensor-common-03.dtsi"
#include "../yupik-sec-m52-sensor-pinctrl-03.dtsi"
#include "./yupik-sec-m52xq-pm-common.dtsi"
#include "yupik-sec-m52xq-camera-sensor-common.dtsi"

#include "yupik-sec-m52xq-pinctrl-r03.dtsi"

/ {
	model = "Samsung M52XQ PROJECT (board-id,03)";
	qcom,msm-id = <475 0x10000>, <515 0x10000>;
	qcom,board-id = <34 3>;
	dtbo-version = <0>;
};

