/* Copyright (c) 2021, The Linux Foundation. All rights reserved.
 *
 * This program is free software; you can redistribute it and/or modify
 * it under the terms of the GNU General Public License version 2 and
 * only version 2 as published by the Free Software Foundation.
 *
 * This program is distributed in the hope that it will be useful,
 * but WITHOUT ANY WARRANTY; without even the implied warranty of
 * MERCHANTABILITY or FITNESS FOR A PARTICULAR PURPOSE.  See the
 * GNU General Public License for more details.
 */

#include "../../yupik-sec-common.dtsi"

#include "../yupik-sec-a52-common.dtsi"
#include "../yupik-sec-a52-pinctrl-common.dtsi"
#include "../yupik-sec-a52-audio-common.dtsi"
#include "../yupik-sec-a52-audio-pinctrl-common.dtsi"
#include "yupik-sec-a52sxq-pm-common.dtsi"
#include "yupik-sec-a52-camera-sensor-common.dtsi"
#include "../yupik-sec-a52-sensor-common.dtsi"
#include "../yupik-sec-a52-sensor-pinctrl-common.dtsi"

#include "yupik-sec-a52sxq-pinctrl-r02.dtsi"

/ {
	model = "Samsung A52SXQ PROJECT (board-id,02)";
	qcom,msm-id = <475 0x10000>, <515 0x10000>;
	qcom,board-id = <34 2>;
	dtbo-version = <0>;
};
